## boards/shields/menura/Kconfig.defconfig
```kconfig
if SHIELD_MENURA_DONGLE || SHIELD_MENURA_CENTRAL_LEFT

config ZMK_KEYBOARD_NAME
    default "menura"

config ZMK_SPLIT_ROLE_CENTRAL
    default y

endif

if SHIELD_MENURA_DONGLE

config ZMK_SPLIT_BLE_CENTRAL_PERIPHERALS
    default 2

config BT_MAX_CONN
    default 5

config BT_MAX_PAIRED
    default 5

endif

if SHIELD_MENURA_DONGLE || SHIELD_MENURA_CENTRAL_LEFT || SHIELD_MENURA_PERIPHERAL_LEFT || SHIELD_MENURA_PERIPHERAL_RIGHT

config ZMK_SPLIT
    default y

endif
```

## boards/shields/menura/Kconfig.shield
```kconfig
config SHIELD_MENURA_CENTRAL_LEFT
    def_bool $(shields_list_contains,menura_central_left)

config SHIELD_MENURA_PERIPHERAL_RIGHT
    def_bool $(shields_list_contains,menura_peripheral_right)

config SHIELD_MENURA_DONGLE
    def_bool $(shields_list_contains,menura_dongle)

config SHIELD_MENURA_PERIPHERAL_LEFT
    def_bool $(shields_list_contains,menura_peripheral_left)
```
